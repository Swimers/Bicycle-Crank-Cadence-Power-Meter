## Software/nRF52832_DemoBoard/boards/cadence/nrf52832_proto/board.yml
```yaml
board:
  name: nrf52832_proto
  full_name: NRF52832 3.3V Header Prototype
  vendor: others
  socs:
    - name: nrf52832
```
