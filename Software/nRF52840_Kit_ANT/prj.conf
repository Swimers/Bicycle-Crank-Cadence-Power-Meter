## CMakeLists.txt
```
cmake_minimum_required(VERSION 3.20.0)
find_package(Zephyr REQUIRED HINTS $ENV{ZEPHYR_BASE})

project(nRF52840_Kit_ANT)

target_sources(app PRIVATE src/main.c src/ant_decode.c)
target_sources_ifdef(CONFIG_ANT app PRIVATE src/ant_receiver.c)
```

## sysbuild.conf
```
# Use the board's UF2 code partition instead of an all-flash app partition.
SB_CONFIG_PARTITION_MANAGER=n
```

## prj.conf
```kconfig
# The board enables USB CDC ACM console and initialization by default.
CONFIG_REBOOT=y
```

## ant.conf
```kconfig
# ANT Add-on v2.1.1 / NCS v3.2.4, for non-commercial evaluation only.
CONFIG_ANT=y
CONFIG_ANT_EVALUATION_KEY=y
CONFIG_ANT_KEY_MANAGER=y
CONFIG_ANT_TOTAL_CHANNELS_ALLOCATED=1
CONFIG_HEAP_MEM_POOL_SIZE=4096
```

## src/main.c
```c
#include <zephyr/kernel.h>
#include <zephyr/device.h>
#include <zephyr/devicetree.h>
#include <zephyr/drivers/uart.h>
#include <zephyr/sys/reboot.h>
#include <hal/nrf_power.h>
#include <string.h>

#if defined(CONFIG_ANT)
#include "ant_receiver.h"
#include <zephyr/sys/printk.h>
#endif

/* Adafruit nRF52 bootloader v0.6.0: enter USB MSC + CDC UF2 mode. */
#define ADAFRUIT_UF2_MAGIC 0x57U
#define COMMAND_CAPACITY 32U

static void reply(const struct device *uart, const char *message)
{
	while (*message != '\0') {
		uart_poll_out(uart, (unsigned char)*message++);
	}
}

int main(void)
{
	const struct device *const uart = DEVICE_DT_GET(DT_CHOSEN(zephyr_console));
	char command[COMMAND_CAPACITY];
	size_t len = 0;
	bool invalid = false;
	unsigned char byte;

	if (!device_is_ready(uart)) {
		return 0;
	}

	/* Zephyr 4.2 CDC ACM queues its first OUT transfer on RX enable.
	 * uart_poll_in() alone does not arm the endpoint on that version.
	 */
#if defined(CONFIG_UART_INTERRUPT_DRIVEN)
	uart_irq_rx_enable(uart);
#endif

#if defined(CONFIG_ANT)
	int ant_err = ant_receiver_start();
	char ant_status[96];
	snprintk(ant_status, sizeof(ant_status),
		 "{\"v\":1,\"type\":\"status\",\"ant_start_error\":%d}\n", ant_err);
	reply(uart, ant_status);
#endif

	for (;;) {
#if defined(CONFIG_ANT)
		ant_receiver_process(uart);
#endif
		if (uart_poll_in(uart, &byte) != 0) {
			k_sleep(K_MSEC(10));
			continue;
		}

		if (byte == '\n') {
			/* Accept LF and CRLF, but not embedded CR or NUL. */
			if (len > 0 && command[len - 1] == '\r') {
				len--;
			}
			command[len] = '\0';
			if (!invalid && strcmp(command, "PING") == 0) {
				reply(uart, "PONG\r\n");
#if defined(CONFIG_ANT)
			} else if (!invalid && strcmp(command, "STATUS") == 0) {
				reply(uart, ant_status);
#endif
			} else if (!invalid && strcmp(command, "BOOTLOADER") == 0) {
				reply(uart, "OK BOOTLOADER\r\n");
				/* Best effort only: CDC does not confirm host receipt. */
				k_sleep(K_MSEC(300));
				NRF_POWER->GPREGRET = ADAFRUIT_UF2_MAGIC;
				sys_reboot(SYS_REBOOT_COLD);
			} else if (invalid || len != 0) {
				reply(uart, "ERR COMMAND\r\n");
			}
			len = 0;
			invalid = false;
		} else if (byte == '\0' || (len > 0 && command[len - 1] == '\r')) {
			invalid = true;
		} else if (len < sizeof(command) - 1) {
			command[len++] = (char)byte;
		} else {
			/* Discard the entire overlong line until its newline. */
			invalid = true;
		}
	}
}
```

## src/ant_decode.c
```c
#include "ant_decode.h"

#include <string.h>

/* Provisional application policy, not an ANT+ profile requirement. */
#define CADENCE_STOP_MS 3000U
#define CADENCE_REBASE_MS 60000U
#define MAX_CADENCE_RPM_X10 3000U

static uint16_t le16(const uint8_t *p)
{
	return (uint16_t)p[0] | ((uint16_t)p[1] << 8);
}

static void cadence_update(struct ant_decode_state *state, const uint8_t *p,
			   uint32_t now, struct ant_measurement *out)
{
	uint16_t time = le16(p);
	uint16_t count = le16(p + 2);
	uint32_t elapsed = now - state->last_crank_ms;

	if (!state->cadence_baseline_valid || elapsed >= CADENCE_REBASE_MS) {
		state->cadence_baseline_valid = true;
		state->crank_time = time;
		state->crank_count = count;
		state->last_crank_ms = now;
		return;
	}

	uint16_t revolutions = (uint16_t)(count - state->crank_count);
	uint16_t ticks = (uint16_t)(time - state->crank_time);

	if (revolutions == 0) {
		if (elapsed >= CADENCE_STOP_MS) {
			out->has_cadence = true;
			out->cadence_rpm_x10 = 0;
		}
		return;
	}

	state->crank_time = time;
	state->crank_count = count;
	state->last_crank_ms = now;
	if (ticks != 0) {
		uint32_t rpm_x10 = (uint32_t)((uint64_t)revolutions * 614400U / ticks);
		if (rpm_x10 <= MAX_CADENCE_RPM_X10) {
			out->has_cadence = true;
			out->cadence_rpm_x10 = (uint16_t)rpm_x10;
		}
	}
}

bool ant_decode_page(struct ant_decode_state *state, uint8_t device_type,
		     const uint8_t payload[8], uint32_t now_ms,
		     struct ant_measurement *out)
{
	if (state == NULL || payload == NULL || out == NULL) {
		return false;
	}
	memset(out, 0, sizeof(*out));
	if (device_type == 120U && (payload[0] & 0x7fU) <= 7U) {
		out->heart_rate_bpm = payload[7];
		out->has_heart_rate = payload[7] != 0xffU;
		return true;
	}
	if (device_type == 11U && payload[0] == 0x10U) {
		out->power_w = le16(payload + 6);
		out->has_power = out->power_w != 0xffffU;
		if (payload[3] != 0xffU) {
			out->has_cadence = true;
			out->cadence_rpm_x10 = (uint16_t)payload[3] * 10U;
		}
		return true;
	}
	if (device_type == 121U) {
		cadence_update(state, payload, now_ms, out);
		return true;
	}
	if (device_type == 122U && (payload[0] & 0x7fU) <= 5U) {
		cadence_update(state, payload + 4, now_ms, out);
		return true;
	}
	return false;
}
```

## src/ant_decode.h
```c
#ifndef CADENCE_ANT_DECODE_H_
#define CADENCE_ANT_DECODE_H_

#include <stdbool.h>
#include <stdint.h>

/* Caller owns one state per (device number, type, transmission type). */
struct ant_decode_state {
	bool cadence_baseline_valid;
	uint16_t crank_time;
	uint16_t crank_count;
	uint32_t last_crank_ms;
};

struct ant_measurement {
	bool has_heart_rate;
	bool has_cadence;
	bool has_power;
	uint8_t heart_rate_bpm;
	uint16_t cadence_rpm_x10;
	uint16_t power_w;
};

/* Decode an eight-byte ANT+ broadcast page. Returns false for unsupported pages. */
bool ant_decode_page(struct ant_decode_state *state, uint8_t device_type,
		     const uint8_t payload[8], uint32_t now_ms,
		     struct ant_measurement *out);

#endif
```

## src/ant_receiver.c
```c
#include "ant_receiver.h"
#include "ant_decode.h"

#include <ant_host_init.h>
#include <ant_interface.h>
#include <ant_key_manager.h>
#include <ant_parameters.h>
#include <zephyr/drivers/uart.h>
#include <zephyr/kernel.h>
#include <zephyr/sys/atomic.h>
#include <zephyr/sys/printk.h>
#include <string.h>

#define RX_CHANNEL 0U
#define ANT_NETWORK 0U
#define ANT_RF_FREQUENCY 57U
#define DEVICE_CAPACITY 24U
#define DEVICE_STALE_MS 60000U

struct frame {
	uint16_t id;
	uint8_t type;
	uint8_t transmission;
	uint8_t payload[8];
	uint32_t time_ms;
};

struct slot {
	bool used;
	uint16_t id;
	uint8_t type;
	uint8_t transmission;
	uint32_t last_seen;
	struct ant_decode_state decode;
};

K_MSGQ_DEFINE(frames, sizeof(struct frame), 32, 4);
static struct slot slots[DEVICE_CAPACITY];
static atomic_t queue_drops;
static uint32_t slot_drops;

static void on_ant_event(ant_evt_t *event)
{
	ANT_MESSAGE *msg = &event->message;

	if (event->channel != RX_CHANNEL || event->event != EVENT_RX ||
	    (msg->ANT_MESSAGE_ucMesgID != MESG_BROADCAST_DATA_ID &&
	     msg->ANT_MESSAGE_ucMesgID != MESG_ACKNOWLEDGED_DATA_ID) ||
	    msg->ANT_MESSAGE_ucSize < 14U ||
	    !msg->ANT_MESSAGE_stExtMesgBF.bANTDeviceID) {
		return;
	}
	const uint8_t *id = msg->ANT_MESSAGE_aucExtData;
	struct frame f = {
		.id = (uint16_t)id[0] | ((uint16_t)id[1] << 8),
		.type = id[2] & 0x7fU,
		.transmission = id[3],
		.time_ms = k_uptime_get_32(),
	};
	memcpy(f.payload, msg->ANT_MESSAGE_aucPayload, sizeof(f.payload));
	if (k_msgq_put(&frames, &f, K_NO_WAIT) != 0) {
		atomic_inc(&queue_drops);
	}
}

int ant_receiver_start(void)
{
	int err = ant_init();
	if (err) { return err; }
	err = ant_cb_register(on_ant_event);
	if (err) { return err; }
	err = ant_plus_key_set(ANT_NETWORK);
	if (err) { return err; }
	err = ant_lib_config_set(ANT_LIB_CONFIG_MESG_OUT_INC_DEVICE_ID);
	if (err) { return err; }
	err = ant_channel_assign(RX_CHANNEL, CHANNEL_TYPE_SLAVE, ANT_NETWORK,
				 EXT_PARAM_ALWAYS_SEARCH);
	if (err) { return err; }
	err = ant_channel_id_set(RX_CHANNEL, 0, 0, 0);
	if (err) { return err; }
	err = ant_channel_radio_freq_set(RX_CHANNEL, ANT_RF_FREQUENCY);
	if (err) { return err; }
	err = ant_channel_low_priority_rx_search_timeout_set(RX_CHANNEL, 0xff);
	if (err) { return err; }
	err = ant_channel_search_timeout_set(RX_CHANNEL, 0);
	if (err) { return err; }
	return ant_channel_open(RX_CHANNEL);
}

static struct slot *get_slot(const struct frame *f)
{
	struct slot *free_slot = NULL;

	for (size_t i = 0; i < ARRAY_SIZE(slots); ++i) {
		struct slot *s = &slots[i];
		if (s->used && s->id == f->id && s->type == f->type &&
		    s->transmission == f->transmission) {
			return s;
		}
		if ((!s->used || (uint32_t)(f->time_ms - s->last_seen) > DEVICE_STALE_MS) &&
		    free_slot == NULL) {
			free_slot = s;
		}
	}
	if (free_slot != NULL) {
		memset(free_slot, 0, sizeof(*free_slot));
		free_slot->used = true;
		free_slot->id = f->id;
		free_slot->type = f->type;
		free_slot->transmission = f->transmission;
	}
	return free_slot;
}

static void send_text(const struct device *uart, const char *text)
{
	while (*text != '\0') {
		uart_poll_out(uart, (unsigned char)*text++);
	}
}

void ant_receiver_process(const struct device *uart)
{
	struct frame f;
	if (k_msgq_get(&frames, &f, K_NO_WAIT) != 0) {
		return;
	}
	struct slot *slot = get_slot(&f);
	if (slot == NULL) {
		slot_drops++;
		return;
	}
	slot->last_seen = f.time_ms;
	struct ant_measurement m;
	bool supported = ant_decode_page(&slot->decode, f.type, f.payload, f.time_ms, &m);
	char hr[12] = "null", cadence[16] = "null", power[12] = "null";
	if (supported && m.has_heart_rate) { snprintk(hr, sizeof(hr), "%u", m.heart_rate_bpm); }
	if (supported && m.has_cadence) {
		snprintk(cadence, sizeof(cadence), "%u.%u", m.cadence_rpm_x10 / 10U,
			 m.cadence_rpm_x10 % 10U);
	}
	if (supported && m.has_power) { snprintk(power, sizeof(power), "%u", m.power_w); }
	char line[256];
	snprintk(line, sizeof(line),
		 "{\"v\":1,\"type\":\"measurement\",\"device_id\":%u,\"device_type\":%u,"
		 "\"transmission_type\":%u,\"uptime_ms\":%u,\"heart_rate_bpm\":%s,"
		 "\"cadence_rpm\":%s,\"power_w\":%s,\"raw\":\"%02x%02x%02x%02x%02x%02x%02x%02x\","
		 "\"queue_drops\":%u,\"slot_drops\":%u}\n",
		 f.id, f.type, f.transmission, f.time_ms, hr, cadence, power,
		 f.payload[0], f.payload[1], f.payload[2], f.payload[3], f.payload[4],
		 f.payload[5], f.payload[6], f.payload[7],
		 (unsigned int)atomic_get(&queue_drops), slot_drops);
	send_text(uart, line);
}
```

## src/ant_receiver.h
```c
#ifndef CADENCE_ANT_RECEIVER_H_
#define CADENCE_ANT_RECEIVER_H_

#include <zephyr/device.h>

/* Call from main thread. Callback only enqueues frames; it never writes USB. */
int ant_receiver_start(void);
void ant_receiver_process(const struct device *uart);

#endif
```
