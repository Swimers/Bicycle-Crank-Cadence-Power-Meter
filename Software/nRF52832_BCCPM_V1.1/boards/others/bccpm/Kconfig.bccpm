## Software/nRF52832_BCCPM_V1.1/boards/others/bccpm/board.yml
```yaml
board:
  name: bccpm
  full_name: BCCPM V1.1 nRF52832
  vendor: others
  socs:
    - name: nrf52832
```

## Software/nRF52832_CadanceSensor/boards/swimers/cadence_sensor/Kconfig.cadence_sensor
```kconfig
# SPDX-License-Identifier: Apache-2.0

config BOARD_CADENCE_SENSOR
	select SOC_NRF52832_QFAA
```

## Software/nRF52832_CadanceSensor/boards/swimers/cadence_sensor/board.yml
```yaml
board:
  name: cadence_sensor
  full_name: Cadence Sensor
  vendor: swimers
  socs:
    - name: nrf52832
```

## Software/nRF52832_Demo/boards/others/cadence_sensor/board.yml
```yaml
board:
  name: cadence_sensor
  full_name: CadenceSensor nRF52832 Demo Board
  vendor: others
  socs:
    - name: nrf52832
```

## Software/nRF52832_Demo/build/nRF52832_Demo/Kconfig/boards/Kconfig.defconfig
```kconfig
# Load Zephyr board defconfig descriptions.
osource "D:/ncs/v3.4.1/zephyr/boards/nordic/nrf52dk/Kconfig.defconfig"
```

## Software/nRF52832_Demo/build/nRF52832_Demo/Kconfig/boards/Kconfig.nrf52dk.tmp
```kconfig
# Load board Kconfig descriptions.
osource "D:/ncs/v3.4.1/zephyr/boards/nordic/nrf52dk/Kconfig.nrf52dk"
```
